## Config.in
```kconfig
source "$BR2_EXTERNAL_MENDELEEV_PATH/package/mqtt2mendeleev/Config.in"
source "$BR2_EXTERNAL_MENDELEEV_PATH/package/libmendeleev/Config.in"
source "$BR2_EXTERNAL_MENDELEEV_PATH/package/uart-enable-rs485/Config.in"
source "$BR2_EXTERNAL_MENDELEEV_PATH/package/inputevent/Config.in"
source "$BR2_EXTERNAL_MENDELEEV_PATH/package/libartnet/Config.in"
source "$BR2_EXTERNAL_MENDELEEV_PATH/package/artnet2mendeleev/Config.in"
```

## configs/mendeleev_bbb_defconfig
```kconfig
BR2_arm=y
BR2_cortex_a8=y
BR2_CCACHE=y
BR2_GLOBAL_PATCH_DIR="$(BR2_EXTERNAL_MENDELEEV_PATH)/board/bbb/patches"
BR2_PACKAGE_HOST_LINUX_HEADERS_CUSTOM_4_9=y
BR2_TOOLCHAIN_BUILDROOT_WCHAR=y
BR2_TOOLCHAIN_BUILDROOT_CXX=y
BR2_TARGET_GENERIC_HOSTNAME="mendeleev"
BR2_TARGET_GENERIC_ISSUE="Welcome to Mendeleev OS"
BR2_ROOTFS_DEVICE_CREATION_DYNAMIC_EUDEV=y
BR2_TARGET_GENERIC_GETTY_PORT="ttyO0"
# BR2_TARGET_GENERIC_REMOUNT_ROOTFS_RW is not set
BR2_SYSTEM_DHCP="eth0"
BR2_TARGET_TZ_INFO=y
BR2_TARGET_LOCALTIME="Europe/Brussels"
BR2_ROOTFS_OVERLAY="$(BR2_EXTERNAL_MENDELEEV_PATH)/board/mendeleev/rootfs_overlay $(BR2_EXTERNAL_MENDELEEV_PATH)/board/bbb/rootfs_overlay"
BR2_ROOTFS_POST_BUILD_SCRIPT="$(BR2_EXTERNAL_MENDELEEV_PATH)/board/mendeleev/post-build.sh $(BR2_EXTERNAL_MENDELEEV_PATH)/board/bbb/post-build.sh"
BR2_ROOTFS_POST_IMAGE_SCRIPT="$(BR2_EXTERNAL_MENDELEEV_PATH)/board/bbb/post-image.sh"
BR2_LINUX_KERNEL=y
BR2_LINUX_KERNEL_CUSTOM_GIT=y
BR2_LINUX_KERNEL_CUSTOM_REPO_URL="https://github.com/RobertCNelson/linux-stable-rcn-ee"
BR2_LINUX_KERNEL_CUSTOM_REPO_VERSION="4.9.36-ti-r46"
BR2_LINUX_KERNEL_USE_CUSTOM_CONFIG=y
BR2_LINUX_KERNEL_CUSTOM_CONFIG_FILE="$(BR2_EXTERNAL_MENDELEEV_PATH)/board/bbb/kernel.config"
BR2_LINUX_KERNEL_DTS_SUPPORT=y
BR2_LINUX_KERNEL_CUSTOM_DTS_PATH="$(BR2_EXTERNAL_MENDELEEV_PATH)/board/bbb/bernardo.dts"
BR2_PACKAGE_E2FSPROGS=y
BR2_PACKAGE_E2FSPROGS_RESIZE2FS=y
BR2_PACKAGE_AVAHI=y
BR2_PACKAGE_AVAHI_DAEMON=y
BR2_PACKAGE_AVAHI_LIBDNSSD_COMPATIBILITY=y
BR2_PACKAGE_DROPBEAR=y
BR2_PACKAGE_DROPBEAR_DISABLE_REVERSEDNS=y
BR2_PACKAGE_DROPBEAR_WTMP=y
BR2_PACKAGE_NTP=y
BR2_PACKAGE_RSYNC=y
BR2_TARGET_ROOTFS_CPIO_GZIP=y
BR2_TARGET_ROOTFS_INITRAMFS=y
# BR2_TARGET_ROOTFS_TAR is not set
BR2_TARGET_UBOOT=y
BR2_TARGET_UBOOT_BUILD_SYSTEM_KCONFIG=y
BR2_TARGET_UBOOT_CUSTOM_GIT=y
BR2_TARGET_UBOOT_CUSTOM_REPO_URL="https://github.com/u-boot/u-boot"
BR2_TARGET_UBOOT_CUSTOM_REPO_VERSION="v2018.01"
BR2_TARGET_UBOOT_PATCH="$(BR2_EXTERNAL_MENDELEEV_PATH)/board/bbb/u-boot"
BR2_TARGET_UBOOT_BOARD_DEFCONFIG="am335x_boneblack"
BR2_TARGET_UBOOT_NEEDS_DTC=y
# BR2_TARGET_UBOOT_FORMAT_BIN is not set
BR2_TARGET_UBOOT_FORMAT_IMG=y
BR2_TARGET_UBOOT_FORMAT_CUSTOM=y
BR2_TARGET_UBOOT_FORMAT_CUSTOM_NAME="spl/u-boot-spl.bin"
BR2_TARGET_UBOOT_SPL=y
BR2_TARGET_UBOOT_SPL_NAME="MLO"
BR2_PACKAGE_HOST_DOSFSTOOLS=y
BR2_PACKAGE_HOST_GENIMAGE=y
BR2_PACKAGE_HOST_MTOOLS=y
BR2_PACKAGE_MQTT2MENDELEEV=y
BR2_PACKAGE_UART_ENABLE_RS485=y
```

## configs/mendeleev_cm4_defconfig
```kconfig
BR2_aarch64=y
BR2_cortex_a72=y
BR2_ARM_FPU_VFPV4=y
BR2_PACKAGE_HOST_LINUX_HEADERS_CUSTOM_5_10=y
BR2_PACKAGE_GLIBC_UTILS=y
BR2_TOOLCHAIN_BUILDROOT_CXX=y
BR2_CCACHE=y
BR2_PACKAGE_OVERRIDE_FILE="$(BR2_EXTERNAL_MENDELEEV_PATH)/local.mk"
BR2_GLOBAL_PATCH_DIR="$(BR2_EXTERNAL_MENDELEEV_PATH)/board/cm4/patches"
BR2_TARGET_GENERIC_HOSTNAME="mendeleev"
BR2_TARGET_GENERIC_ISSUE="Welcome to Mendeleev OS"
BR2_ROOTFS_DEVICE_CREATION_DYNAMIC_EUDEV=y
# BR2_TARGET_GENERIC_GETTY is not set
# BR2_TARGET_GENERIC_REMOUNT_ROOTFS_RW is not set
BR2_TARGET_TZ_INFO=y
BR2_TARGET_LOCALTIME="Europe/Brussels"
BR2_ROOTFS_OVERLAY="$(BR2_EXTERNAL_MENDELEEV_PATH)/board/mendeleev/rootfs_overlay $(BR2_EXTERNAL_MENDELEEV_PATH)/board/cm4/rootfs_overlay"
BR2_ROOTFS_POST_BUILD_SCRIPT="$(BR2_EXTERNAL_MENDELEEV_PATH)/board/mendeleev/real-dirs.sh $(BR2_EXTERNAL_MENDELEEV_PATH)/board/mendeleev/sw-version.sh $(BR2_EXTERNAL_MENDELEEV_PATH)/board/mendeleev/post-build.sh $(BR2_EXTERNAL_MENDELEEV_PATH)/board/cm4/post-build.sh"
BR2_ROOTFS_POST_IMAGE_SCRIPT="$(BR2_EXTERNAL_MENDELEEV_PATH)/board/cm4/post-image.sh"
BR2_ROOTFS_POST_SCRIPT_ARGS="--rpi4 --linuxdir=$(LINUX_DIR)"
BR2_LINUX_KERNEL=y
BR2_LINUX_KERNEL_CUSTOM_TARBALL=y
BR2_LINUX_KERNEL_CUSTOM_TARBALL_LOCATION="$(call github,raspberrypi,linux,0b54dbda3cca2beb51e236a25738784e90853b64)/linux-0b54dbda3cca2beb51e236a25738784e90853b64.tar.gz"
BR2_LINUX_KERNEL_DEFCONFIG="bcm2711"
BR2_LINUX_KERNEL_CONFIG_FRAGMENT_FILES="$(BR2_EXTERNAL_MENDELEEV_PATH)/board/mendeleev/kernel.frag $(BR2_EXTERNAL_MENDELEEV_PATH)/board/cm4/usbgadget.frag"
BR2_LINUX_KERNEL_DTS_SUPPORT=y
BR2_LINUX_KERNEL_INTREE_DTS_NAME="broadcom/bcm2711-rpi-4-b broadcom/bcm2711-rpi-cm4"
BR2_LINUX_KERNEL_NEEDS_HOST_OPENSSL=y
BR2_PACKAGE_BUSYBOX_CONFIG_FRAGMENT_FILES="$(BR2_EXTERNAL_MENDELEEV_PATH)/board/mendeleev/busybox.frag"
BR2_PACKAGE_BUSYBOX_SHOW_OTHERS=y
BR2_PACKAGE_JQ=y
BR2_PACKAGE_DOSFSTOOLS=y
BR2_PACKAGE_DOSFSTOOLS_MKFS_FAT=y
BR2_PACKAGE_E2FSPROGS=y
BR2_PACKAGE_E2FSPROGS_RESIZE2FS=y
BR2_PACKAGE_BRCMFMAC_SDIO_FIRMWARE_RPI=y
BR2_PACKAGE_BRCMFMAC_SDIO_FIRMWARE_RPI_BT=y
BR2_PACKAGE_BRCMFMAC_SDIO_FIRMWARE_RPI_WIFI=y
BR2_PACKAGE_RPI_FIRMWARE=y
BR2_PACKAGE_RPI_FIRMWARE_VARIANT_PI4=y
BR2_PACKAGE_RPI_FIRMWARE_CONFIG_FILE="$(BR2_EXTERNAL_MENDELEEV_PATH)/board/cm4/config.txt"
# BR2_PACKAGE_EUDEV_ENABLE_HWDB is not set
BR2_PACKAGE_PARTED=y
BR2_PACKAGE_CA_CERTIFICATES=y
BR2_PACKAGE_LIBCURL_CURL=y
BR2_PACKAGE_AVAHI=y
BR2_PACKAGE_AVAHI_DAEMON=y
BR2_PACKAGE_AVAHI_LIBDNSSD_COMPATIBILITY=y
BR2_PACKAGE_DNSMASQ=y
# BR2_PACKAGE_DNSMASQ_TFTP is not set
BR2_PACKAGE_DROPBEAR=y
BR2_PACKAGE_DROPBEAR_DISABLE_REVERSEDNS=y
BR2_PACKAGE_DROPBEAR_WTMP=y
BR2_PACKAGE_HOSTAPD=y
BR2_PACKAGE_HOSTAPD_WPS=y
BR2_PACKAGE_IPTABLES=y
BR2_PACKAGE_NTP=y
BR2_PACKAGE_RSYNC=y
BR2_PACKAGE_RAUC=y
BR2_PACKAGE_RAUC_NETWORK=y
BR2_PACKAGE_UTIL_LINUX_HWCLOCK=y
BR2_TARGET_ROOTFS_CPIO_GZIP=y
BR2_TARGET_ROOTFS_INITRAMFS=y
# BR2_TARGET_ROOTFS_TAR is not set
BR2_PACKAGE_HOST_DOSFSTOOLS=y
BR2_PACKAGE_HOST_GENIMAGE=y
BR2_PACKAGE_HOST_MTOOLS=y
BR2_PACKAGE_HOST_RASPBERRYPI_USBBOOT=y
BR2_PACKAGE_INPUTEVENT=y
BR2_PACKAGE_PYTHON_MENDELEEV=y
BR2_PYMENDELEEV_INIT_SCRIPT=y
```

## configs/mendeleev_rpi3_defconfig
```kconfig
BR2_arm=y
BR2_cortex_a53=y
BR2_ARM_FPU_NEON_VFPV4=y
BR2_CCACHE=y
BR2_PACKAGE_HOST_LINUX_HEADERS_CUSTOM_4_9=y
BR2_TOOLCHAIN_BUILDROOT_CXX=y
BR2_TARGET_GENERIC_HOSTNAME="mendeleev"
BR2_TARGET_GENERIC_ISSUE="Welcome to Mendeleev OS"
# BR2_TARGET_GENERIC_REMOUNT_ROOTFS_RW is not set
BR2_SYSTEM_DHCP="eth0"
BR2_TARGET_TZ_INFO=y
BR2_TARGET_LOCALTIME="Europe/Brussels"
BR2_ROOTFS_OVERLAY="$(BR2_EXTERNAL_MENDELEEV_PATH)/board/mendeleev/rootfs_overlay"
BR2_ROOTFS_POST_BUILD_SCRIPT="$(BR2_EXTERNAL_MENDELEEV_PATH)/board/rpi3/post-build.sh"
BR2_ROOTFS_POST_IMAGE_SCRIPT="$(BR2_EXTERNAL_MENDELEEV_PATH)/board/rpi3/post-image.sh"
BR2_LINUX_KERNEL=y
BR2_LINUX_KERNEL_CUSTOM_GIT=y
BR2_LINUX_KERNEL_CUSTOM_REPO_URL="https://github.com/raspberrypi/linux.git"
BR2_LINUX_KERNEL_CUSTOM_REPO_VERSION="5e4ee836560d4c0371e109bf469e1ad808ae7a44"
BR2_LINUX_KERNEL_PATCH="$(BR2_EXTERNAL_MENDELEEV_PATH)/board/rpi3/linux-patches"
BR2_LINUX_KERNEL_USE_CUSTOM_CONFIG=y
BR2_LINUX_KERNEL_CUSTOM_CONFIG_FILE="$(BR2_EXTERNAL_MENDELEEV_PATH)/board/rpi3/kernel.config"
BR2_LINUX_KERNEL_DTS_SUPPORT=y
BR2_LINUX_KERNEL_INTREE_DTS_NAME="bcm2710-rpi-3-b bcm2710-rpi-cm3"
BR2_PACKAGE_E2FSPROGS=y
BR2_PACKAGE_E2FSPROGS_RESIZE2FS=y
BR2_PACKAGE_RPI_FIRMWARE=y
BR2_PACKAGE_AVAHI=y
BR2_PACKAGE_AVAHI_DAEMON=y
BR2_PACKAGE_AVAHI_LIBDNSSD_COMPATIBILITY=y
BR2_PACKAGE_DROPBEAR=y
BR2_PACKAGE_DROPBEAR_DISABLE_REVERSEDNS=y
BR2_PACKAGE_DROPBEAR_WTMP=y
BR2_PACKAGE_NTP=y
BR2_PACKAGE_RSYNC=y
BR2_TARGET_ROOTFS_CPIO_GZIP=y
BR2_TARGET_ROOTFS_INITRAMFS=y
# BR2_TARGET_ROOTFS_TAR is not set
BR2_PACKAGE_HOST_DOSFSTOOLS=y
BR2_PACKAGE_HOST_GENIMAGE=y
BR2_PACKAGE_HOST_MTOOLS=y
BR2_PACKAGE_MQTT2MENDELEEV=y
```

## package/artnet2mendeleev/Config.in
```kconfig
config BR2_PACKAGE_ARTNET2MENDELEEV
	bool "artnet2mendeleev"
	select BR2_PACKAGE_LIBARTNET
	select BR2_PACKAGE_MOSQUITTO
	help
	  Artnet to Mendeleev bridge

	  https://area3001.com
```

## package/libartnet/Config.in
```kconfig
config BR2_PACKAGE_LIBARTNET
	bool "libartnet"
	help
	  libartnet C library

	  https://github.com/OpenLightingProject/libartnet
```

## package/libmendeleev/Config.in
```kconfig
config BR2_PACKAGE_LIBMENDELEEV
	bool "libmendeleev"
	help
	  libmendeleev C library

	  https://area3001.com
```

## package/mqtt2mendeleev/Config.in
```kconfig
config BR2_PACKAGE_MQTT2MENDELEEV
	bool "mqtt2mendeleev"
	select BR2_PACKAGE_LIBMENDELEEV
	select BR2_PACKAGE_MOSQUITTO
	help
	  MQTT to Mendeleev project

	  https://area3001.com
```

## package/pymqtt2mendeleev/Config.in
```kconfig
config BR2_PACKAGE_PYMQTT2MENDELEEV
	bool "mqtt2mendeleev"
	select BR2_PACKAGE_PYTHON_MENDELEEV
	select BR2_PACKAGE_MOSQUITTO
	help
	  MQTT to Mendeleev project

	  https://area3001.com
```

## package/python-asyncio-mqtt/Config.in
```kconfig
config BR2_PACKAGE_PYTHON_ASYNCIO_MQTT
	bool "python-asyncio-mqtt"
	select BR2_PACKAGE_PYTHON3_SSL
	select BR2_PACKAGE_PYTHON_PAHO_MQTT
	help
	  asyncio-mqtt combines the stability of the time-proven paho-mqtt
	  library with a modern, asyncio-based interface.

	  https://github.com/sbtinstruments/asyncio-mqtt
```

## package/python-mendeleev/Config.in
```kconfig
config BR2_PACKAGE_PYTHON_MENDELEEV
	bool "python-mendeleev"
	select BR2_PACKAGE_PYTHON3
	select BR2_PACKAGE_PYTHON_SCAPY
	select BR2_PACKAGE_PYTHON_SERIAL_ASYNCIO
	select BR2_PACKAGE_PYTHON_ASYNC_TIMEOUT
	select BR2_PACKAGE_MOSQUITTO
	select BR2_PACKAGE_PYTHON_ASYNCIO_MQTT
	help
	  pymendeleev

if BR2_PACKAGE_PYTHON_MENDELEEV

config BR2_PYMENDELEEV_INIT_SCRIPT
	bool "install mqtt2mendeleev init script"
	help
	  Install mqtt2mendeleev init script

endif
```
